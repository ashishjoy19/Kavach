## examples/kavach_demo/main/Kconfig.projbuild
```kconfig
# Kavach project options: WiFi, MQTT broker, topics.
# These appear in idf.py menuconfig under "Kavach Configuration".

menu "Kavach Configuration"

    config KAVACH_WIFI_SSID
        string "WiFi SSID"
        default "myssid"
        help
            SSID of the AP to connect to (your PC's network or router).

    config KAVACH_WIFI_PASSWORD
        string "WiFi Password"
        default "mypassword"
        help
            Password of the AP.

    config KAVACH_MQTT_BROKER_URI
        string "MQTT Broker URI"
        default "mqtt://192.168.1.100:1883"
        help
            URI of the MQTT broker (e.g. mqtt://broker.hivemq.com:1883 or local mqtt://<PC_IP>:1883).

    config KAVACH_MQTT_USERNAME
        string "MQTT username (leave empty for no auth)"
        default ""
        help
            Username for broker authentication. Leave empty for anonymous brokers.

    config KAVACH_MQTT_PASSWORD
        string "MQTT password (leave empty for no auth)"
        default ""
        help
            Password for broker authentication. Leave empty for anonymous brokers.

    config KAVACH_MQTT_TOPIC_HELP
        string "Topic for help/alert/call (publish)"
        default "fabacademy/kavach/help"
        help
            Help-related commands (I need help, Send alert, Call family) published here for emergency contacts.

    config KAVACH_MQTT_TOPIC_APPLIANCES
        string "Topic for appliance commands (publish)"
        default "fabacademy/kavach/appliances"
        help
            Appliance commands (light on/off, play, pause, etc.) published here for your app to control IoT devices.

    config KAVACH_MQTT_TOPIC_SENSOR
        string "Topic for temperature/humidity (publish)"
        default "fabacademy/kavach/sensor"
        help
            Temperature and humidity published here periodically (e.g. every 30 s) when sensor is available.

    config KAVACH_MQTT_SENSOR_INTERVAL_SEC
        int "Sensor publish interval (seconds)"
        default 30
        range 10 300
        help
            How often to publish temperature and humidity to the sensor topic.

    config KAVACH_TIMEZONE
        string "Timezone for display (TZ string)"
        default "IST-5:30"
        help
            POSIX TZ string. Examples: IST-5:30 (India), CST-8 (China), EST5EDT (US Eastern),
            JST-9 (Japan), UTC (no offset). Time is synced via NTP; this only affects local display.

    choice
        prompt "Wake word"
        default KAVACH_WAKE_WORD_HIESP
        help
            Wake word(s) to start voice commands. Ensure the selected model is included in the
            ESP Speech Recognition model partition (menuconfig -> ESP Speech Recognition -> WakeNet Model).
        config KAVACH_WAKE_WORD_HIESP
            bool "Hi ESP"
        config KAVACH_WAKE_WORD_ALEXA
            bool "Alexa"
        config KAVACH_WAKE_WORD_BOTH
            bool "Hi ESP and Alexa"
            help
                Tries a combined multi-wake model first; falls back to Hi ESP if not found.
    endchoice

endmenu
```
